&arria10_hps_0_i_sdmmc_sdmmc {
                cap-sd-highspeed;
                broken-cd;
                clock-freq-min-max = <400000 25000000>;
                pwr-en = <0>;
};

&arria10_hps_0_i_usbotg_0_globgrp {
                dr_mode = "host";
};
